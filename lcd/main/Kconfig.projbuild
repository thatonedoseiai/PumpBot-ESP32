## lcd/main/Kconfig.projbuild
```kconfig
menu "Example Configuration"

    config LCD_OVERCLOCK
        bool
        prompt "Run LCD at 40MHz"
        default "n"
        help
            The ILI9341 specifies that the maximum clock speed for the SPI interface is 10MHz. However,
            26MHz is fine. HOWEVER, some ESP32 pin configurations can only do 26MHz, not 40MHz.
            Select this to run at 40MHz.

endmenu
```
